## boards/ingchips/ing20_mini/Kconfig.ing20_mini
```kconfig
# SPDX-License-Identifier: Apache-2.0

config BOARD_ING20_MINI
	select SOC_ING20XX
```

## boards/ingchips/ing20_mini/board.yml
```yaml
board:
  name: ing20_mini
  full_name: ING20 Mini
  vendor: ingchips
  socs:
    - name: ing20xx
```

## boards/ingchips/ing9168_mini/Kconfig.ing9168_mini
```kconfig
# SPDX-License-Identifier: Apache-2.0

config BOARD_ING9168_MINI
	select SOC_ING9168
```

## boards/ingchips/ing9168_mini/board.yml
```yaml
board:
  name: ing9168_mini
  full_name: ING9168 Mini
  vendor: ingchips
  socs:
    - name: ing9168
```

## boards/ingchips/ing9188_mini/Kconfig.ing9188_mini
```kconfig
# SPDX-License-Identifier: Apache-2.0

config BOARD_ING9188_MINI
	select SOC_ING9188
```

## boards/ingchips/ing9188_mini/board.yml
```yaml
board:
  name: ing9188_mini
  full_name: ING9188 Mini
  vendor: ingchips
  socs:
    - name: ing9188
```

## drivers/adc/Kconfig.ingsoc
```kconfig
# Copyright (c) 2026 INGCHIPS
# SPDX-License-Identifier: Apache-2.0

config ADC_INGSOC
	bool "INGCHIPS ING916 ADC driver"
	default y
	depends on DT_HAS_INGCHIPS_ING916_ADC_ENABLED
	help
	  Enable the register-level ADC driver for ING916 series SoCs.
```

## drivers/counter/Kconfig.ingchips
```kconfig
config COUNTER_INGCHIPS_RTC
	bool "INGCHIPS RTC counter"
	default y
	depends on DT_HAS_INGCHIPS_ING916_RTC_ENABLED || DT_HAS_INGCHIPS_ING918_RTC_ENABLED
```

## drivers/dma/Kconfig.ingsoc
```kconfig
# SPDX-License-Identifier: Apache-2.0

config DMA_INGCHIPS
	bool "INGCHIPS ING916/ING20 DMA controller"
	default y
	depends on DT_HAS_INGCHIPS_DMA_ENABLED
	depends on SOC_SERIES_ING916 || SOC_SERIES_ING20
	depends on !DMA_64BIT
	help
	  Enable the register-level DMA controller driver found in ING916 and
	  ING20 SoCs. The driver supports single-block transfers between memory
	  and peripherals.
```

## drivers/gpio/Kconfig.ingsoc
```kconfig
# SPDX-License-Identifier: Apache-2.0

config GPIO_INGSOC
	bool "INGCHIPS register-level GPIO driver"
	default y
	depends on DT_HAS_INGCHIPS_ING916_GPIO_ENABLED || DT_HAS_INGCHIPS_ING918_GPIO_ENABLED
	help
	  GPIO driver using direct register access instead of FWlib.
```

## drivers/i2c/Kconfig.ingchips
```kconfig
config I2C_INGCHIPS
	bool "INGCHIPS I2C controller"
	default y
	depends on DT_HAS_INGCHIPS_ING916_I2C_ENABLED || DT_HAS_INGCHIPS_ING918_I2C_ENABLED
	select I2C_TRANSFER_TIMEOUT_SUPPORTED
```

## drivers/i2s/Kconfig.ingchips
```kconfig
config I2S_INGCHIPS
	bool "INGCHIPS ING916 I2S controller"
	default y
	depends on DT_HAS_INGCHIPS_ING916_I2S_ENABLED
```

## drivers/pwm/Kconfig.ingchips
```kconfig
config PWM_INGCHIPS
	bool "INGCHIPS PWM controller"
	default y
	depends on DT_HAS_INGCHIPS_ING916_PWM_ENABLED || DT_HAS_INGCHIPS_ING918_PWM_ENABLED
```

## drivers/serial/Kconfig.ingsoc
```kconfig
# SPDX-License-Identifier: Apache-2.0

config UART_INGSOC
	bool "INGCHIPS register-level UART driver"
	default y
	depends on DT_HAS_INGCHIPS_UART_ENABLED
	select SERIAL_HAS_DRIVER
	help
	  Polling UART driver using direct register access instead of FWlib.
```

## drivers/spi/Kconfig.ingchips
```kconfig
config SPI_INGCHIPS
	bool "INGCHIPS SPI controller"
	default y
	depends on DT_HAS_INGCHIPS_ING916_SPI_ENABLED || DT_HAS_INGCHIPS_ING918_SPI_ENABLED

config SPI_INGCHIPS_TRANSFER_TIMEOUT_MS
	int "Polling transfer timeout in milliseconds"
	default 500
	depends on SPI_INGCHIPS
	range 1 60000
```

## drivers/watchdog/Kconfig.ingchips
```kconfig
config WDT_INGCHIPS
	bool "INGCHIPS watchdog"
	default y
	depends on DT_HAS_INGCHIPS_ING916_WDT_ENABLED || DT_HAS_INGCHIPS_ING918_WDT_ENABLED
```

## dts/bindings/adc/ingchips,ing916-adc.yaml
```yaml
description: INGCHIPS ING916 successive-approximation ADC

compatible: "ingchips,ing916-adc"

include:
  - name: adc-controller.yaml
  - name: base.yaml

properties:
  reg:
    required: true

  "#io-channel-cells":
    const: 1

io-channel-cells:
  - input
```

## dts/bindings/counter/ingchips,ing916-rtc.yaml
```yaml
description: ING916 always-on RTC counter
compatible: "ingchips,ing916-rtc"
include: base.yaml
properties:
  reg: {required: true}
  reg-names: {required: true}
```

## dts/bindings/counter/ingchips,ing918-rtc.yaml
```yaml
description: ING918 always-on RTC counter
compatible: "ingchips,ing918-rtc"
include: base.yaml
properties:
  reg: {required: true}
```

## dts/bindings/dma/ingchips,dma.yaml
```yaml
# SPDX-License-Identifier: Apache-2.0

description: INGCHIPS ING916 and ING20 DMA controller

compatible: "ingchips,dma"

include: dma-controller.yaml

properties:
  reg:
    required: true

  reg-names:
    required: true

  dma-channels:
    const: 8

  dma-requests:
    const: 16

  dma-buf-addr-alignment:
    const: 1

  dma-buf-size-alignment:
    const: 1

  dma-copy-alignment:
    const: 1

  "#dma-cells":
    const: 2
    description: |
      The first cell is the DMA channel. The second cell is the peripheral
      request selector. Request selectors 0 through 7 are peripheral-to-memory
      sources, while selectors 8 through 15 are memory-to-peripheral targets.

dma-cells:
  - channel
  - request
```

## dts/bindings/gpio/ingchips,gpio.yaml
```yaml
description: INGCHIPS ING916 GPIO controller
compatible: "ingchips,ing916-gpio"
include: [gpio-controller.yaml, base.yaml]
properties:
  reg:
    required: true

gpio-cells:
  - pin
  - flags
```

## dts/bindings/gpio/ingchips,ing918-gpio.yaml
```yaml
description: INGCHIPS ING918 GPIO controller
compatible: "ingchips,ing918-gpio"
include: [gpio-controller.yaml, base.yaml]
properties:
  reg:
    required: true
```

## dts/bindings/i2c/ingchips,ing916-i2c.yaml
```yaml
description: ING916 I2C controller
compatible: "ingchips,ing916-i2c"
include: [i2c-controller.yaml, base.yaml]
properties:
  reg:
    required: true
  input-clock-frequency:
    type: int
    required: true
```

## dts/bindings/i2c/ingchips,ing918-i2c.yaml
```yaml
description: ING918 I2C controller
compatible: "ingchips,ing918-i2c"
include: [i2c-controller.yaml, base.yaml]
properties:
  reg:
    required: true
  input-clock-frequency:
    type: int
    required: true
```

## dts/bindings/i2s/ingchips,ing916-i2s.yaml
```yaml
description: ING916 I2S controller
compatible: "ingchips,ing916-i2s"
include: [i2s-controller.yaml, base.yaml]
properties:
  reg: {required: true}
  input-clock-frequency: {type: int, required: true}
```
