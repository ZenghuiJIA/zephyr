/* SPDX-License-Identifier: Apache-2.0 */
/dts-v1/;
#include <ingchips/ing9188.dtsi>
/ {
	model = "INGCHIPS ING9188 Mini";
	compatible = "ingchips,ing9188-mini";
	chosen { zephyr,console = &uart0; zephyr,shell-uart = &uart0; };
};
&uart0 { status = "okay"; };
&gpio0 { status = "okay"; };
