## dts/bindings/pwm/ingchips,ing916-pwm.yaml
```yaml
description: ING916 dedicated PWM controller
compatible: "ingchips,ing916-pwm"
include: [pwm-controller.yaml, base.yaml]
properties:
  reg: {required: true}
  input-clock-frequency: {type: int, required: true}
  "#pwm-cells": {const: 3}
pwm-cells: [channel, period, flags]
```

## dts/bindings/pwm/ingchips,ing918-pwm.yaml
```yaml
description: ING918 dedicated PWM controller
compatible: "ingchips,ing918-pwm"
include: [pwm-controller.yaml, base.yaml]
properties:
  reg: {required: true}
  input-clock-frequency: {type: int, required: true}
  "#pwm-cells": {const: 3}
pwm-cells: [channel, period, flags]
```

## dts/bindings/serial/ingchips,uart.yaml
```yaml
description: INGCHIPS APB UART
compatible: "ingchips,uart"
include: uart-controller.yaml
properties:
  reg:
    required: true
  clock-frequency:
    required: true
```

## dts/bindings/spi/ingchips,ing916-spi.yaml
```yaml
description: ING916 SPI controller
compatible: "ingchips,ing916-spi"
include: [spi-controller.yaml, base.yaml]
properties:
  reg: {required: true}
  input-clock-frequency: {type: int, required: true}
```

## dts/bindings/spi/ingchips,ing918-spi.yaml
```yaml
description: ING918 PrimeCell-style SSP controller
compatible: "ingchips,ing918-spi"
include: [spi-controller.yaml, base.yaml]
properties:
  reg: {required: true}
  input-clock-frequency: {type: int, required: true}
```

## dts/bindings/watchdog/ingchips,ing916-wdt.yaml
```yaml
description: ING916 watchdog
compatible: "ingchips,ing916-wdt"
include: base.yaml
properties:
  reg: {required: true}
  reg-names: {required: true}
```

## dts/bindings/watchdog/ingchips,ing918-wdt.yaml
```yaml
description: ING918 timer watchdog
compatible: "ingchips,ing918-wdt"
include: base.yaml
properties:
  reg: {required: true}
  input-clock-frequency: {type: int, required: true}
```

## samples/boards/ingchips/led_blinky/sample.yaml
```yaml
sample:
  name: INGchips dual LED blinky
  description: Blink the LEDs connected to IO21 and IO22 through the Zephyr GPIO API.
common:
  build_only: true
  integration_platforms:
    - ing20_mini/ing20xx
  platform_allow:
    - ing20_mini/ing20xx
  tags:
    - gpio
    - led
tests:
  sample.boards.ingchips.led_blinky: {}
```

## soc/ingchips/Kconfig
```kconfig
# SPDX-License-Identifier: Apache-2.0

config SOC_FAMILY_INGCHIPS
	bool
	select BUILD_OUTPUT_HEX

config INGCHIPS_PLATFORM
	bool "INGCHIPS platform firmware integration"
	default y

config INGCHIPS_PLATFORM_OS
	bool
	select THREAD_STACK_INFO
	select DYNAMIC_THREAD
	help
	  Keep the SDK platform vector table active and hand Zephyr's scheduler
	  exception handlers to the platform through gen_os_driver_t.

rsource "ing916/Kconfig"
rsource "ing20/Kconfig"
rsource "ing918/Kconfig"
```

## soc/ingchips/Kconfig.defconfig
```kconfig
# SPDX-License-Identifier: Apache-2.0

if INGCHIPS_PLATFORM_OS

config HEAP_MEM_POOL_SIZE
	default 4096

endif

rsource "ing916/Kconfig.defconfig"
rsource "ing20/Kconfig.defconfig"
rsource "ing918/Kconfig.defconfig"
```

## soc/ingchips/Kconfig.soc
```kconfig
# SPDX-License-Identifier: Apache-2.0
rsource "ing916/Kconfig.soc"
rsource "ing20/Kconfig.soc"
rsource "ing918/Kconfig.soc"
```

## soc/ingchips/ing20/Kconfig
```kconfig
# SPDX-License-Identifier: Apache-2.0

config SOC_SERIES_ING20
	select ARM
	select CPU_CORTEX_M3
	select CPU_HAS_ARM_MPU
	select CPU_CORTEX_M_HAS_VTOR
	select INIT_ARCH_HW_AT_BOOT
	select HAS_PM
	select XIP
	select INGCHIPS_PLATFORM_OS
```

## soc/ingchips/ing20/Kconfig.soc
```kconfig
# SPDX-License-Identifier: Apache-2.0

config SOC_SERIES_ING20
	bool
	select SOC_FAMILY_INGCHIPS

config SOC_ING20XX
	bool
	select SOC_SERIES_ING20

config SOC_SERIES
	default "ing20" if SOC_SERIES_ING20

config SOC
	default "ing20xx" if SOC_ING20XX
```

## soc/ingchips/ing916/Kconfig.defconfig
```kconfig
# SPDX-License-Identifier: Apache-2.0

if SOC_SERIES_ING916

config NUM_IRQS
	default 47

config SYS_CLOCK_HW_CYCLES_PER_SEC
	default 12000000

endif # SOC_SERIES_ING916
```

## soc/ingchips/ing916/Kconfig.soc
```kconfig
# SPDX-License-Identifier: Apache-2.0
config SOC_SERIES_ING916
	bool
	select SOC_FAMILY_INGCHIPS
config SOC_ING9168
	bool
	select SOC_SERIES_ING916
config SOC_SERIES
	default "ing916" if SOC_SERIES_ING916
config SOC
	default "ing9168" if SOC_ING9168
```

## soc/ingchips/ing918/Kconfig
```kconfig
# SPDX-License-Identifier: Apache-2.0

config SOC_SERIES_ING918
	select ARM
	select CPU_CORTEX_M3
	select CPU_HAS_ARM_MPU
	select CPU_CORTEX_M_HAS_VTOR
	select XIP
	select INGCHIPS_PLATFORM_OS
```

## soc/ingchips/ing918/Kconfig.defconfig
```kconfig
# SPDX-License-Identifier: Apache-2.0

if SOC_SERIES_ING918

config NUM_IRQS
	default 32

config SYS_CLOCK_HW_CYCLES_PER_SEC
	default 12000000

endif # SOC_SERIES_ING918
```

## soc/ingchips/ing918/Kconfig.soc
```kconfig
# SPDX-License-Identifier: Apache-2.0

config SOC_SERIES_ING918
	bool
	select SOC_FAMILY_INGCHIPS

config SOC_ING9188
	bool
	select SOC_SERIES_ING918

config SOC_SERIES
	default "ing918" if SOC_SERIES_ING918

config SOC
	default "ing9188" if SOC_ING9188
```

## tests/drivers/ingchips/build_all/testcase.yaml
```yaml
tests:
  drivers.ingchips.build_all.ing20:
    build_only: true
    platform_allow:
      - ing20_mini/ing20xx
    extra_args:
      - DTC_OVERLAY_FILE=ing20.overlay
      - EXTRA_CONF_FILE=dma.conf
  drivers.ingchips.build_all.ing9168:
    build_only: true
    platform_allow:
      - ing9168_mini/ing9168
    extra_args:
      - DTC_OVERLAY_FILE=ing9168.overlay
      - EXTRA_CONF_FILE=dma.conf
  drivers.ingchips.build_all.ing9188:
    build_only: true
    platform_allow:
      - ing9188_mini/ing9188
    extra_args:
      - DTC_OVERLAY_FILE=ing9188.overlay
```
